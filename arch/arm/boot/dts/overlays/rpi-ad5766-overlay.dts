/dts-v1/;
/plugin/;

/ {
	compatible = "brcm,bcm2708", "brcm,bcm2837";

	fragment@0 {
		target = <&spi0>;
		__overlay__ {
			#address-cells = <1>;
			#size-cells = <0>;
			status = "okay";

			ad5766@0{
				compatible = "adi,ad5766";
				reg = <0>;
				spi-max-frequency = <25000000>;
			};
		};
	};
};